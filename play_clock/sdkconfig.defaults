## play_clock/sdkconfig.defaults
```kconfig
# ESP32 Play Clock - Default Configuration
# Override flash size to 2MB for actual hardware

CONFIG_ESPTOOLPY_FLASHSIZE_2MB=y
CONFIG_ESPTOOLPY_FLASHSIZE="2MB"

# UART Configuration for CH340C USB-to-Serial
CONFIG_ESPTOOLPY_FLASHMODE_DIO=y
CONFIG_ESPTOOLPY_FLASHFREQ_40M=y
CONFIG_ESPTOOLPY_UPLOADSPEED_921600=y
CONFIG_ESPTOOLPY_MONITOR_BAUD_115200=y
CONFIG_ESPTOOLPY_MONITOR_BAUD=115200

# UART0 (Console) Configuration
CONFIG_UART_ISR_IN_IRAM=y
CONFIG_UART0_TX_GPIO_NUM=1
CONFIG_UART0_RX_GPIO_NUM=3

# Partition table
CONFIG_PARTITION_TABLE_SINGLE_APP=y
CONFIG_PARTITION_TABLE_FILENAME="partitions_singleapp.csv"

# Disable Bluetooth for radio module
CONFIG_BT_ENABLED=n
CONFIG_BT_BLUEDROID_ENABLED=n
CONFIG_BLE_ENABLED=n

# Enable WiFi for mesh networking (if needed)
CONFIG_WIFI_ENABLED=y

# Optimizations for scoreboard module
CONFIG_FREERTOS_HZ=1000
CONFIG_ESP32_DEFAULT_CPU_FREQ_240=y
```
